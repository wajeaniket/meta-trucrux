## conf/layer.conf
```bitbake
# We have a conf and classes directory, add to BBPATH
BBPATH .= ":${LAYERDIR}"

# We have a packages directory, add to BBFILES
BBFILES += "${LAYERDIR}/recipes-*/*/*.bb \
            ${LAYERDIR}/recipes-*/*/*.bbappend"

BBFILE_COLLECTIONS += "trucrux"
BBFILE_PATTERN_trucrux := "^${LAYERDIR}/"
BBFILE_PRIORITY_trucrux = "9"

LAYERSERIES_COMPAT_trucrux = "dunfell"

BBFILES_DYNAMIC += " \
    qt5-layer:${LAYERDIR}/dynamic-layers/qt5-layer/*/*/*.bb \
    qt5-layer:${LAYERDIR}/dynamic-layers/qt5-layer/*/*/*.bbappend \
    \
    swupdate:${LAYERDIR}/dynamic-layers/swupdate/*.bb \
    swupdate:${LAYERDIR}/dynamic-layers/swupdate/*.bbappend \
    \
    virtualization-layer:${LAYERDIR}/dynamic-layers/virtualization/*/*/*.bb \
    virtualization-layer:${LAYERDIR}/dynamic-layers/virtualization/*/*/*.bbappend \
   \
    freescale-distro:${LAYERDIR}/dynamic-layers/freescale-distro/*/*/*.bb \
    freescale-distro:${LAYERDIR}/dynamic-layers/freescale-distro/*/*/*.bbappend \
"
```

## conf/machine/imx8mm-trux-q01.conf
```bitbake
#@TYPE: Machine
#@NAME: imx8mm-trux-q01
#@SOC: i.MX8MM
#@DESCRIPTION: Machine configuration for imx8mm-trux-q01
#
# http://www.trucrux.com

MACHINEOVERRIDES =. "mx8:mx8m:mx8mm:"
require conf/machine/include/imx-base.inc
require conf/machine/include/tune-cortexa53.inc

require trucrux.inc
require trucrux_bcm43xx.inc

KERNEL_DEVICETREE = " \
	freescale/imx8mm-trux-8MDVP.dtb \
"

IMAGE_BOOTFILES_DEPENDS += "imx-m4-demos:do_deploy"
IMAGE_BOOTFILES += "imx8mm_m4_TCM_hello_world.bin \
                    imx8mm_m4_TCM_rpmsg_lite_pingpong_rtos_linux_remote.bin \
                    imx8mm_m4_TCM_rpmsg_lite_str_echo_rtos.bin \
                    imx8mm_m4_TCM_sai_low_power_audio.bin \
"

UBOOT_CONFIG ??= "sd"
UBOOT_CONFIG[sd] = "imx8mm_trucrux_config,sdcard"
SPL_BINARY = "spl/u-boot-spl.bin"

# Set DDR FIRMWARE
DDR_FIRMWARE_NAME = " \
	ddr4_imem_1d.bin \
	ddr4_dmem_1d.bin \
	ddr4_imem_2d.bin \
	ddr4_dmem_2d.bin \
	lpddr4_pmu_train_1d_imem.bin \
	lpddr4_pmu_train_1d_dmem.bin \
	lpddr4_pmu_train_2d_imem.bin \
	lpddr4_pmu_train_2d_dmem.bin \
"
# Set U-Boot DTB
UBOOT_DTB_NAME = "imx8mm-trux-DVP.dtb"

# Set imx-mkimage boot target
IMXBOOT_TARGETS = "flash_lpddr4_ddr4_evk"

SERIAL_CONSOLES = "115200;ttymxc0 115200;ttymxc3"

IMAGE_BOOTLOADER = "imx-boot"

ROOTFS_SIZE = "3700"
LOADADDR = ""
UBOOT_SUFFIX = "bin"
UBOOT_MAKE_TARGET = ""
IMX_BOOT_SEEK = "33"
```
